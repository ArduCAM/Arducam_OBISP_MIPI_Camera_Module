/dts-v1/;

/ {
	compatible = "brcm,bcm2835";

	fragment@0 {
		target = < 0xffffffff >;

		__overlay__ {
			#address-cells = < 0x01 >;
			#size-cells = < 0x00 >;
			status = "okay";

			arducam@10 {
				compatible = "sony,arducam";
				reg = < 0x0c >;
				status = "okay";
				clocks = < 0x01 >;
				clock-names = "xclk";
				VANA-supply = < 0x02 >;
				VDIG-supply = < 0x03 >;
				VDDL-supply = < 0x04 >;
				rotation = < 0xb4 >;
				phandle = < 0x07 >;

				port {

					endpoint {
						remote-endpoint = < 0x05 >;
						clock-lanes = < 0x00 >;
						data-lanes = < 0x01 0x02 >;
						clock-noncontinuous;
						link-frequencies = < 0x00 0x1b2e0200 >;
						phandle = < 0x06 >;
					};
				};
			};
		};
	};

	fragment@1 {
		target = < 0xffffffff >;

		__overlay__ {
			status = "okay";

			port {

				endpoint {
					remote-endpoint = < 0x06 >;
					clock-lanes = < 0x00 >;
					data-lanes = < 0x01 0x02 >;
					clock-noncontinuous;
					phandle = < 0x05 >;
				};
			};
		};
	};

	fragment@2 {
		target = < 0xffffffff >;

		__overlay__ {
			status = "okay";
		};
	};

	fragment@3 {
		target-path = [ 2f 00 ];

		__overlay__ {

			fixedregulator@0 {
				compatible = "regulator-fixed";
				regulator-name = "arducam_vana";
				regulator-min-microvolt = < 0x2ab980 >;
				regulator-max-microvolt = < 0x2ab980 >;
				gpio = < 0xffffffff 0x29 0x00 >;
				enable-active-high;
				phandle = < 0x02 >;
			};

			fixedregulator@1 {
				compatible = "regulator-fixed";
				regulator-name = "arducam_vdig";
				regulator-min-microvolt = < 0x1b7740 >;
				regulator-max-microvolt = < 0x1b7740 >;
				phandle = < 0x03 >;
			};

			fixedregulator@2 {
				compatible = "regulator-fixed";
				regulator-name = "arducam_vddl";
				regulator-min-microvolt = < 0x124f80 >;
				regulator-max-microvolt = < 0x124f80 >;
				phandle = < 0x04 >;
			};

			camera-clk {
				compatible = "fixed-clock";
				#clock-cells = < 0x00 >;
				clock-frequency = < 0x16e3600 >;
				phandle = < 0x01 >;
			};
		};
	};

	fragment@4 {
		target = < 0xffffffff >;

		__overlay__ {
			status = "okay";
		};
	};

	fragment@5 {
		target-path = "/__overrides__";

		__overlay__ {
			cam0-pwdn-ctrl = [ 00 00 00 02 67 70 69 6f 3a 30 00 ];
			cam0-pwdn = [ 00 00 00 02 67 70 69 6f 3a 34 00 ];
		};
	};

	__overrides__ {
		rotation = "\0\0\0\arotation:0";
	};

	__symbols__ {
		arducam = "/fragment@0/__overlay__/arducam@10";
		arducam_0 = "/fragment@0/__overlay__/arducam@10/port/endpoint";
		csi1_ep = "/fragment@1/__overlay__/port/endpoint";
		arducam_vana = "/fragment@3/__overlay__/fixedregulator@0";
		arducam_vdig = "/fragment@3/__overlay__/fixedregulator@1";
		arducam_vddl = "/fragment@3/__overlay__/fixedregulator@2";
		arducam_clk = "/fragment@3/__overlay__/camera-clk";
	};

	__fixups__ {
		i2c_csi_dsi = "/fragment@0:target:0";
		csi1 = "/fragment@1:target:0";
		i2c0if = "/fragment@2:target:0";
		gpio = "/fragment@3/__overlay__/fixedregulator@0:gpio:0";
		i2c0mux = "/fragment@4:target:0";
	};

	__local_fixups__ {

		fragment@0 {

			__overlay__ {

				arducam@10 {
					clocks = < 0x00 >;
					VANA-supply = < 0x00 >;
					VDIG-supply = < 0x00 >;
					VDDL-supply = < 0x00 >;

					port {

						endpoint {
							remote-endpoint = < 0x00 >;
						};
					};
				};
			};
		};

		fragment@1 {

			__overlay__ {

				port {

					endpoint {
						remote-endpoint = < 0x00 >;
					};
				};
			};
		};

		fragment@5 {

			__overlay__ {
				cam0-pwdn-ctrl = < 0x00 >;
				cam0-pwdn = < 0x00 >;
			};
		};

		__overrides__ {
			rotation = < 0x00 >;
		};
	};
};
